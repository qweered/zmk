## app/boards/arm/nrfmicro/Kconfig.board
```kconfig
# nrfmicro board configuration

# Copyright (c) 2020 Pete Johanson
# SPDX-License-Identifier: MIT

config BOARD_NICE_NANO
	bool "nrfmicro"
	depends on SOC_NRF52840_QIAA
```

## app/boards/arm/nrfmicro_flipped/Kconfig.board
```kconfig
# nrfmicro_flipped board configuration

# Copyright (c) 2020 Pete Johanson
# SPDX-License-Identifier: MIT

config BOARD_NRFMICRO_FLIPPED
	bool "nrfmicro_flipped"
	depends on SOC_NRF52840_QIAA
```

## app/boards/arm/nrfmicro_flipped/Kconfig.defconfig
```kconfig
# Electronut Labs Papyr board configuration

# Copyright (c) 2020 Pete Johanson
# SPDX-License-Identifier: MIT

if BOARD_NRFMICRO_FLIPPED

config BOARD
	default "nrfmicro_flipped"

if USB

config USB_NRFX
	default y

config USB_DEVICE_STACK
	default y

endif # USB

config BT_CTLR
	default BT

config ZMK_BLE
	default y

config ZMK_USB
	default y

endif # BOARD_NRFMICRO_FLIPPED
```
